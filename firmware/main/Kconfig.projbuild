## firmware/main/Kconfig.projbuild
```kconfig
menu "Hardware Dog"

    config HWDOG_WIFI_SSID
        string "Wi-Fi network (empty: no network, net.status link is null)"
        default ""

    config HWDOG_WIFI_PASSWORD
        string "Wi-Fi password (stays in your local sdkconfig, never commit it)"
        default ""

    config HWDOG_PWR_SDA
        int "INA226 bus: SDA GPIO"
        default 8

    config HWDOG_PWR_SCL
        int "INA226 bus: SCL GPIO"
        default 9

    config HWDOG_TGT_SDA
        int "Target I2C bus: SDA GPIO"
        default 4

    config HWDOG_TGT_SCL
        int "Target I2C bus: SCL GPIO"
        default 5

    config HWDOG_UART_RX
        int "Target UART: RX GPIO (connect to the target TX)"
        default 18

    config HWDOG_UART_TX
        int "Target UART: TX GPIO (connect to the target RX)"
        default 17

    config HWDOG_INA226_ADDR
        int "INA226 I2C address"
        default 64

    config HWDOG_SHUNT_MOHM
        int "INA226 shunt resistor, milliohm (R100 boards: 100)"
        default 100

    config HWDOG_MAX_CURRENT_MA
        int "Current full scale, mA (shunt x full scale must stay under 81.92 mV)"
        default 800

    config HWDOG_SHUNT_TOL_PERMILLE
        int "Shunt resistor tolerance, in 0.1 % (1 % R100 boards: 10). Sets the declared current accuracy until calibration."
        default 10

    config HWDOG_I2C_WATCH_MS
        int "Scan the target I2C bus from boot every N ms (0: on request only). ACTIVE: each scan probes 0x08-0x77."
        range 0 600000
        default 0

    config HWDOG_ETH_W5500
        bool "W5500 Ethernet on SPI2: the wired network port (wins over Wi-Fi)"
        default n
        select ETH_USE_SPI_ETHERNET
        select ETH_SPI_ETHERNET_W5500

    config HWDOG_ETH_SCLK
        int "W5500 SCLK GPIO"
        depends on HWDOG_ETH_W5500
        default 12

    config HWDOG_ETH_MOSI
        int "W5500 MOSI GPIO"
        depends on HWDOG_ETH_W5500
        default 11

    config HWDOG_ETH_MISO
        int "W5500 MISO GPIO"
        depends on HWDOG_ETH_W5500
        default 13

    config HWDOG_ETH_CS
        int "W5500 CS GPIO"
        depends on HWDOG_ETH_W5500
        default 10

    config HWDOG_ETH_INT
        int "W5500 INT GPIO (-1: not wired, the driver polls)"
        depends on HWDOG_ETH_W5500
        range -1 48
        default 14

    config HWDOG_ETH_RST
        int "W5500 RST GPIO (-1: not wired)"
        depends on HWDOG_ETH_W5500
        range -1 48
        default 21

endmenu
```
